## components/bk_audio/audio_streams/fatfs_stream/Kconfig
```kconfig
menu "Asdf::Audio_streams::Fatfs_stream"
	config ASDF_FATFS_STREAM
		depends on ASDF
		depends on FATFS
		bool "Enable Audio Fatfs stream"
		default n

	config ASDF_FATFS_STREAM_TEST
		depends on ASDF_FATFS_STREAM
		bool "Enable Audio Fatfs stream test"
		default n

endmenu
```

## components/mp3_play/Kconfig
```kconfig
menu "MP3 Play"

	config MP3_PLAY
		depends on AUDIO_PLAY
		bool "Enable MP3 Play"
		default n

	config MP3_PLAY_TEST
		depends on AUDIO_PLAY
		depends on FATFS
		bool "Enable MP3 Play Test"
		default n

endmenu
```
